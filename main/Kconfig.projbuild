## main/Kconfig.projbuild
```kconfig
menu "GM Synth bring-up"

config GM_SYNTH_PCM_ARENA_BYTES
    int "PCM residency arena bytes"
    default 4194304
    range 1048576 6291456
    help
        PSRAM bytes reserved as the contiguous PCM residency arena during
        ESP32-S3 N16R8 bring-up. The production/default value remains 4 MiB;
        dedicated qualification configs may request a larger measured arena.

menu "SF2 storage benchmark"

config GM_SYNTH_STORAGE_BENCHMARK_ENABLE
    bool "Run VFS to PSRAM storage benchmark at boot"
    default n
    help
        Opens an already-mounted VFS path, parses the SF2 smpl payload and
        sweeps 4/8/16/32/64 KiB reads directly into the PCM PSRAM arena.
        This is a bring-up/profile path only and must not run in the audio task.

if GM_SYNTH_STORAGE_BENCHMARK_ENABLE

config GM_SYNTH_STORAGE_BENCHMARK_PATH
    string "Mounted SF2 path"
    default "/sf2/test.sf2"
    help
        VFS path to an SF2 file. The filesystem must already be mounted by the
        board/storage layer before the benchmark runs.

config GM_SYNTH_STORAGE_BENCHMARK_BYTES
    int "Maximum smpl bytes to benchmark"
    default 4194304
    range 65536 6291456
    help
        Maximum contiguous bytes read from the SF2 smpl payload during each
        chunk-size sweep. The actual length is clamped to both smpl size and
        PCM arena capacity.

config GM_SYNTH_PROGRAM_PREPARE_BENCHMARK_ENABLE
    bool "Run source-backed Program Prepare benchmark"
    default n
    help
        After the storage sweep and residency initialization, exercise cold and
        warm Program Prepare, deterministic evictable-cache pressure, safe LRU
        eviction, block-boundary commit/retire, and release-tail Voice Ref
        survival using the same mounted real-SF2 fixture. This is an on-target
        control/storage benchmark only; it must never run in the audio task.

config GM_SYNTH_QEMU_FLASH_SF2_TEST
    bool "Mount benchmark raw FATFS SF2 flash fixture"
    default n
    help
        Integration/qualification build option. Mounts the read-only raw
        SPI-flash FATFS partition labelled qemu_sf2 at /sf2 before the storage
        benchmark. The historical name is retained for compatibility; the same
        raw fixture is intentionally used by QEMU and physical N16R8 builds.

endif

endmenu

menu "Render timing benchmark"

config GM_SYNTH_RENDER_BENCHMARK_ENABLE
    bool "Run deterministic Voice DSP render benchmark at boot"
    default n
    help
        Bring-up/CI benchmark only. Renders fixed Voice-count workloads using
        an in-memory deterministic looping PCM fixture and reports min/avg/
        p50/p95/p99/max block times plus deadline and checksum telemetry.

if GM_SYNTH_RENDER_BENCHMARK_ENABLE

config GM_SYNTH_PHYSICAL_QUALIFICATION_BUILD
    bool "Mark render telemetry as physical qualification evidence"
    default n
    help
        Enable only in the dedicated physical N16R8 qualification image. QEMU
        must leave this disabled so its timing remains explicitly labelled as
        regression telemetry rather than hardware performance evidence.

endif

endmenu

menu "I2S DMA qualification"

config GM_SYNTH_I2S_QUAL_ENABLE
    bool "Run KS_S3_KORVO_V4 ES8311 + I2S/DMA qualification"
    default n
    depends on GM_SYNTH_RENDER_BENCHMARK_ENABLE
    help
        Dedicated physical-audio qualification path for KS_S3_KORVO_V4 /
        ESP32-S3-Korvo-2 routing. A Core-pinned realtime task renders 44.1 kHz
        audio into standard 16-bit stereo Philips I2S frames; renderer L/R is
        averaged to mono and duplicated into both slots for the single ES8311
        DAC / mono speaker path. The codec is held muted with PA off until DMA
        silence has been preloaded and MCLK/BCLK/LRCK are running. Keep this
        disabled in normal and QEMU images; sdkconfig.hwbench.defaults enables
        it with the verified board pin map as the physical compile/runtime gate.

config GM_SYNTH_I2S_QUAL_BCLK_GPIO
    int "I2S BCLK GPIO (-1 = unconfigured)"
    default -1
    range -1 48
    help
        Physical BCLK GPIO. Qualification refuses to start while this is -1.
        KS_S3_KORVO_V4 uses GPIO9.

config GM_SYNTH_I2S_QUAL_WS_GPIO
    int "I2S WS/LRCK GPIO (-1 = unconfigured)"
    default -1
    range -1 48
    help
        Physical WS/LRCK GPIO. Qualification refuses to start while this is -1.
        KS_S3_KORVO_V4 uses GPIO45.

config GM_SYNTH_I2S_QUAL_DOUT_GPIO
    int "I2S DOUT GPIO (-1 = unconfigured)"
    default -1
    range -1 48
    help
        Physical serial audio data output GPIO. Qualification refuses to start
        while this is -1. KS_S3_KORVO_V4 uses GPIO8 for ESP32-S3 -> ES8311.

config GM_SYNTH_I2S_QUAL_MCLK_GPIO
    int "I2S MCLK GPIO (-1 = unconfigured)"
    default -1
    range -1 48
    help
        Physical MCLK output GPIO. The Korvo V4 ES8311 qualification requires
        this to be configured and uses GPIO16 with 256 * Fs = 11.2896 MHz.

config GM_SYNTH_I2S_QUAL_DMA_DESC_NUM
    int "I2S DMA descriptor count"
    default 8
    range 2 16
    help
        Number of TX DMA descriptors. At the default 64 frames per descriptor,
        eight descriptors provide roughly 11.6 ms of queued audio at 44.1 kHz.

config GM_SYNTH_I2S_QUAL_DMA_FRAME_NUM
    int "I2S DMA frames per descriptor"
    default 64
    range 16 511
    help
        Stereo audio frames per DMA descriptor. The qualification default is
        intentionally one synth render block (64 frames).

config GM_SYNTH_I2S_QUAL_WARMUP_BLOCKS
    int "I2S warm-up blocks"
    default 64
    range 8 2048

config GM_SYNTH_I2S_QUAL_MEASURE_BLOCKS
    int "I2S measured blocks"
    default 4096
    range 128 32768
    help
        4096 blocks is about 5.94 seconds at 44.1 kHz / 64 frames per block.

config GM_SYNTH_I2S_QUAL_WRITE_TIMEOUT_MS
    int "I2S blocking write timeout (ms)"
    default 20
    range 2 1000

config GM_SYNTH_I2S_QUAL_TASK_STACK_BYTES
    int "I2S qualification task stack bytes"
    default 8192
    range 4096 32768

config GM_SYNTH_I2S_QUAL_MIN_STACK_HEADROOM_BYTES
    int "Minimum accepted stack high-water headroom bytes"
    default 2048
    range 512 16384

config GM_SYNTH_I2S_QUAL_TASK_PRIORITY
    int "I2S qualification task priority"
    default 20
    range 5 24

config GM_SYNTH_I2S_QUAL_TASK_CORE
    int "I2S qualification task core"
    default 1
    range 0 1

endmenu

endmenu
```

## tests/idf/loop_voice/sdkconfig.defaults
```kconfig
CONFIG_IDF_TARGET="esp32s3"
CONFIG_ESPTOOLPY_FLASHSIZE_4MB=y
CONFIG_ESP_DEFAULT_CPU_FREQ_MHZ_240=y
CONFIG_COMPILER_OPTIMIZATION_PERF=y
CONFIG_ESP_MAIN_TASK_STACK_SIZE=8192
CONFIG_ESP_CONSOLE_UART_DEFAULT=y
CONFIG_ESP_TASK_WDT_TIMEOUT_S=5
CONFIG_ESP_TASK_WDT_PANIC=y
```
